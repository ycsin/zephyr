## prj.conf
```kconfig
CONFIG_PROFILING=y
CONFIG_PROFILING_PERF=y
CONFIG_THREAD_STACK_INFO=y
CONFIG_SMP=n
CONFIG_EVENTS=y
CONFIG_SHELL=y
```

## src/main.c
```c
/*
 *  Copyright (c) 2023 KNS Group LLC (YADRO)
 *
 *  SPDX-License-Identifier: Apache-2.0
 */

#include <zephyr/kernel.h>
#include <stdio.h>

#define WAIT_KOEF USEC_PER_MSEC * 10

#define NOINLINE __attribute__((noinline))

int NOINLINE func_0_0(void)
{
	k_busy_wait(1 * WAIT_KOEF);
	return 0;
}

int NOINLINE func_0_1(void)
{
	k_busy_wait(2 * WAIT_KOEF);
	return 0;
}

int NOINLINE func_0(void)
{
	k_busy_wait(1 * WAIT_KOEF);
	func_0_0();
	func_0_1();
	return 0;
}

int NOINLINE func_1(void)
{
	k_busy_wait(3 * WAIT_KOEF);
	return 0;
}

int NOINLINE func_2(void)
{
	k_busy_wait(4 * WAIT_KOEF);
	return 0;
}

int main(void)
{
	while (1) {
		k_usleep(1000);
		func_0();
		func_1();
		func_2();
	}
	return 0;
}
```
