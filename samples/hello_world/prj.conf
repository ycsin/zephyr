## Kconfig
```
config IRQ_OFFLOAD
	bool "IRQ offload"
	help
	  Enable irq_offload() API which allows functions to be synchronously
	  run in interrupt context. Only useful for test cases that need
	  to validate the correctness of kernel objects in IRQ context.

source "Kconfig.zephyr"
```

## prj.conf
```kconfig
# nothing here
CONFIG_CONSOLE_HANDLER=y
CONFIG_DEBUG=y
```

## src/main.c
```c
/*
 * Copyright (c) 2012-2014 Wind River Systems, Inc.
 *
 * SPDX-License-Identifier: Apache-2.0
 */

#include <stdio.h>

int main(void)
{
	printf("Hello World! %s\n", CONFIG_BOARD_TARGET);

	int c;

	while ((c = getc(stdin)) != EOF) {
		putchar(c);
	}

	return 0;
}
```
