/*
 * Copyright (c) 2026 Yong Cong Sin <yongcong.sin@gmail.com>
 *
 * SPDX-License-Identifier: Apache-2.0
 */

/ {
	shim_dev: shim-dev {
		compatible = "vnd,intc2-shim-dev";
		interrupts = <25 2>;
		interrupt-parent = <&nvic>;
	};
};
