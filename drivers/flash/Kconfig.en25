## drivers/flash/Kconfig.en25
```kconfig
# Copyright (c) 2021 Nordic Semiconductor ASA
# SPDX-License-Identifier: Apache-2.0

menuconfig SPI_FLASH_EN25
	bool "EN25 family flash driver"
	select FLASH_HAS_DRIVER_ENABLED
	depends on SPI
	depends on FLASH
	help
	  This driver can handle several instances of EN25 family chips that
	  are enabled by specifying devicetree nodes with the "compatible"
	  property set to "atmel,at45" and other required properties like
	  JEDEC ID, chip capacity, block and page size etc. configured
	  accordingly.

	  The driver is only capable of using "power of 2" binary page sizes
	  in those chips and at initialization configures them to work in
	  that mode (unless it is already done).

if SPI_FLASH_EN25

config SPI_FLASH_EN25_INIT_PRIORITY
	int "Driver initialization priority"
	default 80
	help
	  Device driver initialization priority.
	  SPI driver needs to be initialized before this one.

config SPI_FLASH_EN25_READY_TIMEOUT
	int "Max duration to wait for ready status of en25 in milliseconds"
	default 10000
	help
	  For some operations the driver must wait for en25 to become ready.
	  This config specifies the maximum duration the driver will wait.

config SPI_FLASH_EN25_JEDEC_CHECK_AT_INIT
	bool "Check JEDEC id during initialization"
	default n
	help
	  If true, JEDEC ID will be checked during initialization, and init will
	  fail if the ID does not match.
	  If false, the check is skipped.

endif # SPI_FLASH_EN25
```

## drivers/modem/Kconfig.quectel
```kconfig
# Copyright (c) 2022 G-Technologies Sdn. Bhd.
# SPDX-License-Identifier: Apache-2.0

config MODEM_GSM_QUECTEL_GNSS
	bool "Enables GNSS functions for Quectel modems"
	default y
	help
	  Enables GPS functions for Quectel modems that support GNSS.

if MODEM_GSM_QUECTEL_GNSS

config MODEM_GSM_QUECTELL_GNSS_SUPL
	bool "Enable SUPL AGPS configuration"
	default y
	help
	  Enable SUPL AGPS configuration.

if MODEM_GSM_QUECTELL_GNSS_SUPL

config MODEM_GSM_QUECTELL_GNSS_SUPL_URL
	string "SUPL AGPS server url"
	default "supl.google.com:7276"
	help
	  SUPL AGPS server url.

endif # MODEM_GSM_QUECTELL_GNSS_SUPL

config MODEM_GSM_QUECTELL_GNSS_QLOC
	bool "Enable QuecLocator configuration"
	default y
	help
	  Enable QuecLocator configuration.

if MODEM_GSM_QUECTELL_GNSS_QLOC

config MODEM_GSM_QUECTELL_GNSS_QLOC_TOK
	string "QuecLocator token"
	default "hHP0F4GoA604u3zn"
	help
	  QuecLocator token.

endif # MODEM_GSM_QUECTELL_GNSS_QLOC

config MODEM_GSM_QUECTEL_GNSS_AUTOSTART
	bool "Autostart GNSS engine"
	default y
	help
	  Autostart GNSS engine.

choice "MODEM_GSM_QUECTEL_GNSS_OP_CHOICE"
	prompt "Quectel GNSS output port"
	default MODEM_GSM_QUECTEL_GNSS_OP_UART

config MODEM_GSM_QUECTEL_GNSS_OP_NONE
	bool "GNSS output to none"
	help
	  GNSS no NMEA output.

config MODEM_GSM_QUECTEL_GNSS_OP_USB
	bool "GNSS output to USB"
	help
	  Route GNSS's NMEA output to USB.

config MODEM_GSM_QUECTEL_GNSS_OP_UART
	bool "GNSS output to UART"
	help
	  Route GNSS's NMEA output to UART.

endchoice

config MODEM_GSM_QUECTEL_GNSS_OP
	string
	default "none" if MODEM_GSM_QUECTEL_GNSS_OP_NONE
	default "usbnmea" if MODEM_GSM_QUECTEL_GNSS_OP_USB
	default "uartdebug" if MODEM_GSM_QUECTEL_GNSS_OP_UART

choice "MODEM_GSM_QUECTEL_GNSS_CONSTELLATION_CHOICE"
	prompt "Quectel GNSS constellation configurations"
	default MODEM_GSM_QUECTEL_GNSS_GN_ON_BD_OFF_GL_OFF

config MODEM_GSM_QUECTEL_GNSS_GN_OFF_BD_OFF_GL_OFF
	bool "GPS on, GLONASS off, BeiDou off, Galileo off"
	help
	  GPS on, GLONASS off, BeiDou off, Galileo off.

config MODEM_GSM_QUECTEL_GNSS_GN_ON_BD_ON_GL_ON
	bool "GPS on, GLONASS on, BeiDou on, Galileo on"
	help
	  GPS on, GLONASS on, BeiDou on, Galileo on.

config MODEM_GSM_QUECTEL_GNSS_GN_ON_BD_ON_GL_OFF
	bool "GPS on, GLONASS on, BeiDou on, Galileo off"
	help
	  GPS on, GLONASS on, BeiDou on, Galileo off.

config MODEM_GSM_QUECTEL_GNSS_GN_ON_BD_OFF_GL_ON
	bool "GPS on, GLONASS on, BeiDou off, Galileo on"
	help
	  GPS on, GLONASS on, BeiDou off, Galileo on.

config MODEM_GSM_QUECTEL_GNSS_GN_ON_BD_OFF_GL_OFF
	bool "GPS on, GLONASS on, BeiDou off, Galileo off"
	help
	  GPS on, GLONASS on, BeiDou off, Galileo off.

config MODEM_GSM_QUECTEL_GNSS_GN_OFF_BD_ON_GL_ON
	bool "GPS on, GLONASS off, BeiDou on, Galileo on"
	help
	  GPS on, GLONASS off, BeiDou on, Galileo on.

config MODEM_GSM_QUECTEL_GNSS_GN_OFF_BD_OFF_GL_ON
	bool "GPS on, GLONASS off, BeiDou off, Galileo on"
	help
	  GPS on, GLONASS off, BeiDou off, Galileo on.

endchoice

config MODEM_GSM_QUECTEL_GNSS_CONSTELLATION
	int
	default 0 if MODEM_GSM_QUECTEL_GNSS_GN_OFF_BD_OFF_GL_OFF
	default 1 if MODEM_GSM_QUECTEL_GNSS_GN_ON_BD_ON_GL_ON
	default 2 if MODEM_GSM_QUECTEL_GNSS_GN_ON_BD_ON_GL_OFF
	default 3 if MODEM_GSM_QUECTEL_GNSS_GN_ON_BD_OFF_GL_ON
	default 4 if MODEM_GSM_QUECTEL_GNSS_GN_ON_BD_OFF_GL_OFF
	default 5 if MODEM_GSM_QUECTEL_GNSS_GN_OFF_BD_ON_GL_ON
	default 6 if MODEM_GSM_QUECTEL_GNSS_GN_OFF_BD_OFF_GL_ON

endif
```

## drivers/sensor/kx022/Kconfig
```kconfig
#Kionix KX022 3 - axis accelerometer driver
#Copyright(c) 2021 G - Technologies Sdn.Bhd.
#
#SPDX - License - Identifier : Apache - 2.0

menuconfig KX022
	bool "KX022 I2C accelerometer sensor driver"
	depends on I2C
	help
	  Enable driver for KX022 accelerometer sensor driver

if KX022

choice KX022_TRIGGER_MODE
	prompt "Trigger mode"
	help
	  Specify the type of triggering to be used by the driver.

config KX022_TRIGGER_NONE
	bool "No trigger"

config KX022_TRIGGER_GLOBAL_THREAD
	bool "Use global thread"
	depends on GPIO
	select KX022_TRIGGER

config KX022_TRIGGER_OWN_THREAD
	bool "Use own thread"
	depends on GPIO
	select KX022_TRIGGER

endchoice

config KX022_TRIGGER
	bool "Trigger"

config KX022_THREAD_PRIORITY
	int "Thread priority"
	depends on KX022_TRIGGER_OWN_THREAD
	default 10
	help
	  Priority of thread used by the driver to handle interrupts.

config KX022_THREAD_STACK_SIZE
	int "Thread stack size"
	depends on KX022_TRIGGER_OWN_THREAD
	default 1024
	help
	  Stack size of thread used by the driver to handle interrupts.

config KX022_DIAGNOSTIC_MODE
	bool "Use diagnostic mode"
	help
	  Get kx022 register value

config KX022_ODR_RUNTIME
	bool "set odr in runtime"
	help
	  Set odr in runtime

config KX022_FS_RUNTIME
	bool "set full-scale in runtime"
	help
	  Set full-scale in runtime

config KX022_RES_RUNTIME
	bool "set resolution in runtime"
	help
	  Set resolution in runtime

config KX022_MOTION_DETECTION_TIMER_RUNTIME
	bool "Set wake up delay time in runtime"
	help
	  Set wake up delay time in runtime

config KX022_MOTION_DETECT_THRESHOLD_RUNTIME
	bool "Set motion detect threshold in runtime"
	help
	  Set motion detect threshold in runtime

config KX022_TILT_TIMER_RUNTIME
	bool "Set tilt timer in runtime"
	help
	  Set tilt timer in runtime

config KX022_TILT_ANGLE_LL_RUNTIME
	bool "Set tilt angle ll in runtime"
	help
	  Set tilt angle ll in runtime

menu "Attributes"
config KX022_INT_PIN_1_POLARITY
	int "Polarity of physical interrupt pin 1"
	range 0 1
	default 1
	help
	  Polarity of Physical Interrupt Pin 1
	  0: active low
	  1: Active high

config KX022_INT_PIN_1_RESPONSE
	int "Response of physical interrupt pin 1"
	range 0 1
	default 0
	help
	  Response of Physical Interrupt Pin 1
	  0: Cleared by reading INT_REL
	  1: One pulse with a period of 50 us

config KX022_FS
	int "Accelerometer full-scale range"
	range 0 2
	default 0
	help
	  Specify the default accelerometer full-scale range.
	  An X value for the config represents a range of +/- X G. Valid values
	  are:
	  0:  +/- 2g
	  1:  +/- 4g
	  2:  +/- 8g

config KX022_ODR
	int "Accelerometer Output data rate frequency"
	range 0 7
	default 2
	help
	  Specify the default accelerometer output data rate expressed in
	  samples per second (Hz).
	  0: 12.5Hz
	  1: 25Hz
	  2: 50Hz
	  3: 100Hz
	  4: 200Hz
	  5: 400Hz
	  6: 800Hz
	  7: 1600Hz

config KX022_RES
	int "Resolution of the KX022"
	range 0 1
	default 1
	help
	  AKA Sensitivity in the datasheet, related to the power of the
	  KX022, the default setting is 16-bit resolution.
	  0: 8-bit
	  1: 16-bit
endmenu

config KX022_MOTION_ODR
	int "Accelerometer motion detect Position Output data rate"
	range 0 8
	default 5
	help
	  Specify the default accelerometer motion detect position output data rate
	  are:
	  0: 0.781Hz
	  1: 1.563Hz
	  2: 3.125Hz
	  3: 6.25Hz
	  4: 12.5hz
	  5: 25hz
	  6: 50hz
	  7: 100hz

config KX022_MOTION_THS
	int "Wake up Motion threshold"
	range 1 16
	default 1
	help
	  The motion threshold is calculated using Formula:
	  value/16 = ths in unit g(default : KX022_FS 2g):
	  1: 0.0625g
	  2: 0.1250g
	  3: 0.1875g
	  ++

config KX022_MOTION_DETECTION_TIMER
	int "motion detection timer"
	range 1 255
	default 6
	help
	  The duration in second for motion,calculated by using this function
	  Value/ Motion Wake-up Output data rate(default:KX022_MOTION_ODR 25hz).
	  ie:
	  1: 0.04s
	  2: 0.08s
	  3: 0.12s
	  4: 0.16s
	  5: 0.20s
	  ++

config KX022_TILT_ODR
	int "Accelerometer Tilt Position Output data rate"
	range 0 3
	default 2
	help
	  Specify the default accelerometer tilt position output data rate
	  are:
	  0: 1.56Hz
	  1: 6.25Hz
	  2: 12.5Hz
	  3: 50Hz

config KX022_TILT_DURATION
	int "Wake up tilt duration"
	range 1 255
	default 3
	help
	  The duration in second for tilt,calculated by using this function
	  Value/ tilt Wake-up Output data rate(default:KX022_TILT_ODR 12.5hz).
	  ie:
	  1: 0.08s
	  2: 0.16s
	  3: 0.24s
	  4: 0.32s
	  5: 0.40s
	  ++

config KX022_TILT_ANGLE_LL_SET
	int "The Tilt Angle lower value default 22 degree"
	range 0 255
	default 12
	help
	  The Tilt Angle High Limit valueis calculated by using the formula below
	  Angle(count) = sin θ*32.

config KX022_TILT_ANGLE_HL_SET
	int "The Tilt Angle High Limit value"
	range 0 255
	default 42
	help
	  The Tilt Angle High Limit valueis calculated by using the formula below
	  Angle(count) = sin θ*32.
	  
endif # KX022
```

## drivers/sensor/mhz19b/Kconfig
```kconfig
# Copyright (c) 2021 G-Technologies Sdn. Bhd.
# SPDX-License-Identifier: Apache-2.0

config MHZ19B
	bool "Winsen CO2 sensor"
	depends on UART_INTERRUPT_DRIVEN
	help
	  Enable driver for the MHZ19B CO2 Sensor.

if MHZ19B

config MHZ19B_KEEP_MCU_AWAKE
	bool "Keep MCU awake while polling"
	depends on PM
	help
	  Keep MCU awake while polling for data. This is required for uart driver
	  that doesn't support wake up from stop mode.

endif # MHZ19B
```

## dts/bindings/misc/zephyr,ipi-plic.yaml
```yaml
# Copyright (c) 2023 Meta
# SPDX-License-Identifier: Apache-2.0

description: IPI PLIC

compatible: "zephyr,ipi-plic"

include: [base.yaml]

properties:
  interrupt-parent:
    required: true

  interrupts:
    required: true
```

## dts/bindings/misc/zephyr,shell-uart.yaml
```yaml
# Copyright (c) 2023 Meta
# SPDX-License-Identifier: Apache-2.0

description: Shell UART Backend

compatible: "zephyr,shell-uart"

include: [base.yaml]

properties:

  uarts:
    type: phandles
    required: true
    description: |
      UART devices to be used by the UART shell backend.
```

## dts/bindings/modem/gsm-ppp.yaml
```yaml
# Copyright (c) 2021 G-Technologies Sdn. Bhd.
# SPDX-License-Identifier: Apache-2.0

description: GSM PPP modem

compatible: "gsm,ppp"

include: uart-device.yaml

properties:
  label:
    required: true

  power-gpios:
    type: phandle-array
    required: false
    description: |
      Pin to enable the power supply to the modem.

  power-key-gpios:
    type: phandle-array
    required: false
    description: |
      Power key pin of the modem.

  power-key-on-ms:
    type: int
    required: false
    description: |
      Duration required to hold the power key for the modem to turn on.

  power-key-off-ms:
    type: int
    required: false
    description: |
      Duration required to hold the power key for the modem to turn off.

  reset-gpios:
    type: phandle-array
    required: false
    description: |
      Reset pin of the modem.

  dtr-gpios:
    type: phandle-array
    required: false
    description: |
      DTR pin of the modem.
```
