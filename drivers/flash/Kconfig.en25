## dts/bindings/sensor/kionix,kx022.yaml
```yaml
# Copyright (c) 2021 G-Technologies Sdn. Bhd.
# SPDX-License-Identifier: Apache-2.0

description: KX022 16-Bit digital I2C Accelerometer sensor

compatible: "kionix,kx022"

include: i2c-device.yaml
properties:
    int-gpios:
      type: phandle-array
      required: false
      description: |
        The INT1 pin

    int-pin:
      type: int
      required: false
      default: 1
      enum:
        - 1
        - 2
      description: |
        Select DRDY pin number (1 or 2).

           1 # drdy is generated from INT1
           2 # drdy is generated from INT2

        This number represents which of the two interrupt pins
        (INT1 or INT2) the drdy line is attached to. This property is not
        mandatory and if not present it defaults to 1 which is the
        configuration at power-up.

    int-pin-1-polarity:
      type: int
      required: false
      default: 1
      enum:
        - 0
        - 1
      description: |
        Polarity of Physical Interrupt Pin 1
        0: active low
        1: Active high

    int-pin-1-response:
      type: int
      required: false
      default: 1
      enum:
        - 0
        - 1
      description: |
        Response of Physical Interrupt Pin 1
        0: Cleared by reading INT_REL
        1: One pulse with a period of 50 us

    full-scale:
      type: int
      required: false
      default: 0
      enum:
        - 0
        - 1
        - 2
      description: |
        Specify the default accelerometer full-scale range.
        An X value for the config represents a range of +/- X G. Valid values
        are:
        0:  +/- 2g
        1:  +/- 4g
        2:  +/- 8g

    odr:
      type: int
      required: false
      default: 2
      enum:
        - 0
        - 1
        - 2
        - 3
        - 4
        - 5
        - 6
        - 7
      description: |
        Specify the default accelerometer output data rate expressed in
        samples per second (Hz).
        0: 12.5Hz
        1: 25Hz
        2: 50Hz
        3: 100Hz
        4: 200Hz
        5: 400Hz
        6: 800Hz
        7: 1600Hz

    resolution:
      type: int
      required: false
      default: 1
      enum:
        - 0
        - 1
      description: |
        Related to the power of theKX022,
        the default setting is 16-bit resolution.
        0: 8-bit
        1: 16-bit
    motion-odr:
      type: int
      required: false
      default: 6
      enum:
        - 0
        - 1
        - 2
        - 3
        - 4
        - 5
        - 6
        - 7
      description: |
        Specify the default accelerometer motion detect position output data rate
        are:
        0: 0.781Hz
        1: 1.563Hz
        2: 3.125Hz
        3: 6.25Hz
        4: 12.5hz
        5: 25hz
        6: 50hz
        7: 100hz

    motion-threshold:
      type: int
      required: false
      default: 1
      description: |
        The motion threshold is calculated using Formula:
        value/16 = ths in unit g(default : KX022_FS 2g):
        1: 0.0625g
        2: 0.1250g
        3: 0.1875g
        ++
        (values range from 0x0 to 0xFF)

    motion-detection-timer:
      type: int
      required: false
      default: 6
      description: |
        The duration in second for motion,calculated by using this function
        Value/ Motion Wake-up Output data rate(default:KX022_MOTION_ODR 25hz).
        ie:
        1: 0.04s
        2: 0.08s
        3: 0.12s
        4: 0.16s
        5: 0.20s
        6: 0.24s
        ++
        (values range from 0x0 to 0xFF)

    tilt-odr:
      type: int
      required: false
      default: 2
      enum:
        - 0
        - 1
        - 2
        - 3
      description: |
        Specify the default accelerometer tilt position output data rate
        are:
        0: 1.56Hz
        1: 6.25Hz
        2: 12.5Hz
        3: 50Hz

    tilt-timer:
      type: int
      required: false
      default: 3
      description: |
        The duration in second for tilt, calculated by using this function
        Value/ tilt Wake-up Output data rate(default:KX022_TILT_ODR 12.5hz).
        ie:
        1: 0.08s
        2: 0.16s
        3: 0.24s
        ++
        (values range from 0x0 to 0xFF)

    tilt-angle-ll:
      type: int
      required: false
      default: 12
      description: |
        The Tilt Angle High Limit value is calculated by using the formula below
        Angle(count) = sin θ*32.
        (values range from 0x0 to 0xFF)
        default is 22°

    tilt-angle-hl:
      type: int
      required: false
      default: 42
      description: |
        The Tilt Angle High Limit value is calculated by using the formula below
        Angle(count) = sin θ*32.
        (values range from 0x0 to 0xFF)
        default is null
```

## lib/posix/Kconfig.signal
```kconfig
# Copyright (c) 2023 Meta
#
# SPDX-License-Identifier: Apache-2.0

config POSIX_SIGNAL
	bool "Support for POSIX signal APIs"
	default y if POSIX_API
	help
	  Enable support for POSIX signal APIs.

if POSIX_SIGNAL
config POSIX_SIGNAL_NSIG
	int "Maximum number of signal"
	default 63
	help
	  Define the maximum number of signal.

config POSIX_SIGNAL_STRING_FULL
	bool "Use full string for the strsignal API"
	help
	  Use full string for the strsignal API.
	  Will use more than 450 bytes of ROM for strings, about
	  200+ bytes more than the default implementation.

endif
```

## soc/riscv/common/Kconfig
```kconfig
# Copyright (c) 2024 Nordic Semiconductor ASA
# SPDX-License-Identifier: Apache-2.0
#

config SOC_NUM_IRQS
	int

source "soc/riscv/common/riscv-privileged/Kconfig"
```

## soc/riscv/gd_gd32/gd32vf103/Kconfig.soc
```kconfig
# GD32VF103 SOC configuration options

# Copyright (c) 2021 Tokita, Hiroshi <tokita.hiroshi@gmail.com>
# SPDX-License-Identifier: Apache-2.0

choice
	prompt "GigaDevice GD32VF103 SOC implementation"
	depends on SOC_SERIES_GD32VF103

config SOC_GD32VF103
	bool "GD32VF103"
	select RISCV_ISA_RV32I
	select RISCV_ISA_EXT_M
	select RISCV_ISA_EXT_A
	select RISCV_ISA_EXT_C
	select RISCV_ISA_EXT_ZICSR
	select RISCV_ISA_EXT_ZIFENCEI

endchoice

if SOC_SERIES_GD32VF103

config SOC_NUM_IRQS
	default 87 if  NUCLEI_ECLIC
	default 16 if !NUCLEI_ECLIC

endif
```

## soc/riscv/nordic_nrf/nrf54h/Kconfig.soc
```kconfig
# Copyright (c) 2024 Nordic Semiconductor ASA
# SPDX-License-Identifier: Apache-2.0

config SOC_NRF54H20
	bool "nRF54H20"
	depends on SOC_SERIES_NRF54HX

if SOC_NRF54H20

choice
	prompt "nRF54Hx MCU Selection"

config SOC_NRF54H20_ENGA_CPUPPR
	bool "nRF54H20 ENGA CPUPPR"
	depends on RISCV_CORE_NORDIC_VPR

endchoice

config SOC_NUM_IRQS
	default 496

endif # SOC_NRF54H20
```

## soc/riscv/riscv-privileged/renode/Kconfig.series
```kconfig
# Copyright (c) 2023 Meta
# SPDX-License-Identifier: Apache-2.0

config SOC_SERIES_RISCV32_RENODE
	bool "Renode RISC-V32 SoC implementation"
	select RISCV
	select SOC_FAMILY_RISCV_PRIVILEGED
	help
	  Enable support for Renode RISC-V
```

## subsys/debug/symtab/Kconfig
```kconfig
# Symtab configuration options

# Copyright (c) 2024 Meta Platforms
# SPDX-License-Identifier: Apache-2.0

menuconfig SYMTAB
	bool "Generate symbol table"
	help
	  Generate the symbol table with the offset and name of every
	  function.
	  The symbol table can be accessed by including the
	  <zephyr/debug/symtab.h> header.

	  Choose N if you have no idea what is this.

if SYMTAB

config SYMTAB_SHELL
	bool "Symtab shell commands"
	depends on SHELL
	help
	  Enable shell commands for symtab.

endif # SYMTAB
```

## subsys/profiling/perf/Kconfig
```kconfig
# Copyright (c) 2023 KNS Group LLC (YADRO)
#
# SPDX-License-Identifier: Apache-2.0

config PROFILING_PERF
	bool "Perf support"
	depends on THREAD_STACK_INFO
	depends on !SMP
	depends on SHELL
	depends on ARCH_HAS_STACKWALK
	help
	  Enable perf shell command.

if PROFILING_PERF

config PROFILING_PERF_BUFFER_SIZE
	int "Perf buffer size"
	default 2048
	help
	  Size of buffer, that used by perf to save samples from stack tracing.

endif
```
