## drivers/interrupt_controller/Kconfig.plic
```kconfig
# Copyright (c) 2022 Carlo Caione <ccaione@baylibre.com>
# SPDX-License-Identifier: Apache-2.0

config PLIC
	bool "Platform Level Interrupt Controller (PLIC)"
	default y
	depends on DT_HAS_SIFIVE_PLIC_1_0_0_ENABLED
	select MULTI_LEVEL_INTERRUPTS
	select 2ND_LEVEL_INTERRUPTS
	help
	  Platform Level Interrupt Controller provides support
	  for external interrupt lines defined by the RISC-V SoC.

if PLIC

config PLIC_SUPPORTS_SOFT_INTERRUPT
	bool
	default y
	depends on DT_HAS_ANDESTECH_NCEPLIC100_ENABLED
	help
	  Enabled when the PLIC supports software-triggered interrupts.

config PLIC_SUPPORTS_TRIG_TYPE
	bool
	default y
	depends on DT_HAS_ANDESTECH_NCEPLIC100_ENABLED
	help
	  Enabled when the PLIC supports multiple trigger types,
	  such as level, edge, etc.

if PLIC_SUPPORTS_TRIG_TYPE

config PLIC_TRIG_TYPE_REG_OFFSET
	hex "Trigger type register offset"
	default 0x1080 if DT_HAS_ANDESTECH_NCEPLIC100_ENABLED
	help
	  Offset to the 'trigger type' register.

config PLIC_TRIG_TYPE_BITWIDTH
	int "Trigger type bitwidth"
	default 1
	help
	  Number of bits required to differentiate between the trigger types.

config PLIC_SUPPORTS_TRIG_EDGE
	bool
	default y
	depends on DT_HAS_ANDESTECH_NCEPLIC100_ENABLED
	help
	  Enabled when the PLIC supports edge-triggered interrupt.

endif # PLIC_SUPPORTS_TRIG_TYPE

config PLIC_IRQ_AFFINITY
	bool "Configure IRQ affinity"
	depends on SMP
	depends on MP_MAX_NUM_CPUS > 1
	# the intc2 affinity ops are implemented on this machinery
	default y if INTC2_PLIC && INTC2_AFFINITY
	help
	  Enable configuration of IRQ affinity.

config PLIC_IRQ_AFFINITY_MASK
	hex "Default IRQ affinity mask"
	depends on PLIC_IRQ_AFFINITY
	default INTC2_AFFINITY_DEFAULT_MASK if INTC2_AFFINITY
	default 0x1
	help
	  Default mask for the driver when IRQ affinity is enabled.

config PLIC_SHELL
	bool "PLIC shell commands"
	depends on SHELL
	help
	  Enable additional shell commands useful for debugging.
	  Caution: This can use quite a bit of RAM (PLICs * IRQs * sizeof(uint16_t)).

if PLIC_SHELL

config PLIC_SHELL_IRQ_COUNT
	bool "IRQ count shell commands"
	default y
	help
	  Records the number of hits per interrupt line and provide shell commands to access them.
	  Caution: This can use quite a bit of RAM (PLICs * IRQs * sizeof(PLIC_IRQ_COUNT_TYPE)).

config PLIC_SHELL_IRQ_AFFINITY
	bool "Shell commands to configure IRQ affinity"
	default y
	depends on PLIC_IRQ_AFFINITY
	help
	  Provide shell commands to configure IRQ affinity in runtime.

endif # PLIC_SHELL

config PLIC_WARM_BOOT
	bool "PLIC warm boot"
	help
	  Disable part of the initialisation in case of a warm boot, for example
	  in case of Asymmetric Multi Processing

config INTC2_PLIC
	bool "intc2 controller node for the PLIC"
	default y
	depends on INTC2_RISCV_CPU_INTC
	# The intc2 dispatch loop completes a claimed line after its handler
	# runs, which is wrong for edge-triggered lines (they must be
	# acknowledged before handling); keep the legacy handler on such
	# hardware until per-line trigger awareness is added.
	depends on !PLIC_SUPPORTS_TRIG_EDGE
	help
	  Define an intc2 controller node for each PLIC instance and route
	  its dispatch through the intc2 graph: the generated chain slot on
	  the CPU-root node replaces the PLIC's legacy per-instance
	  IRQ_CONNECT, and interrupts of devices behind the PLIC - including
	  legacy connects using multilevel-encoded IRQ numbers - dispatch
	  from the PLIC node's own table via claim/complete.

endif # PLIC
```

## drivers/interrupt_controller/Kconfig.riscv_cpu_intc
```kconfig
# Copyright (c) 2026 Yong Cong Sin <yongcong.sin@gmail.com>
# SPDX-License-Identifier: Apache-2.0

config INTC2_RISCV_CPU_INTC
	bool "intc2 root node for the RISC-V CPU interrupt controller"
	default y
	depends on INTC2 && RISCV && DT_HAS_RISCV_CPU_INTC_ENABLED
	# CLIC replaces the CPU intc; the bridge assumes table index == line
	depends on !RISCV_HAS_CLIC
	depends on RISCV_RESERVED_IRQ_ISR_TABLES_OFFSET = 0
	depends on !ISR_TABLES_LOCAL_DECLARATION
	select INTC2_LEGACY_BRIDGE
	help
	  Define the intc2 CPU-root node for the RISC-V CPU interrupt
	  controller. The node's generated dispatch table takes over
	  _sw_isr_table, so legacy and intc2 interrupt connections share
	  one table and both APIs work. Interrupts on chained controllers
	  dispatch through the chained controller's own intc2 node when
	  its driver is converted (see INTC2_PLIC); unconverted chained
	  controllers are a build error for connects on their lines.
```

## tests/drivers/interrupt_controller/intc_aplic_intc2/testcase.yaml
```yaml
common:
  platform_allow:
    - qemu_riscv32/qemu_virt_riscv32/aia-direct
  integration_platforms:
    - qemu_riscv32/qemu_virt_riscv32/aia-direct
  tags:
    - drivers
    - interrupt
    - aplic
    - intc2

tests:
  drivers.interrupt_controller.intc_aplic_intc2.legacy: {}
  drivers.interrupt_controller.intc_aplic_intc2.bridge:
    extra_configs:
      - CONFIG_INTC2=y
```

## tests/drivers/interrupt_controller/intc_gicv3_intc2/testcase.yaml
```yaml
common:
  platform_allow:
    - qemu_cortex_a53
    - qemu_cortex_a53/qemu_cortex_a53/smp
  integration_platforms:
    - qemu_cortex_a53
  tags:
    - drivers
    - interrupt
    - gic
    - intc2

tests:
  drivers.interrupt_controller.intc_gicv3_intc2.legacy: {}
  drivers.interrupt_controller.intc_gicv3_intc2.bridge:
    extra_configs:
      - CONFIG_INTC2=y
  drivers.interrupt_controller.intc_gicv3_intc2.affinity:
    # the SMP variant runs two CPUs with icount off
    platform_allow:
      - qemu_cortex_a53/qemu_cortex_a53/smp
    extra_configs:
      - CONFIG_INTC2=y
      - CONFIG_INTC2_AFFINITY=y
```

## tests/drivers/interrupt_controller/intc_plic_intc2/testcase.yaml
```yaml
common:
  platform_allow:
    - qemu_riscv32
    - qemu_riscv64
  tags:
    - drivers
    - interrupt
    - plic
    - intc2

tests:
  drivers.interrupt_controller.intc_plic_intc2.legacy: {}
  drivers.interrupt_controller.intc_plic_intc2.bridge:
    extra_configs:
      - CONFIG_INTC2=y
  drivers.interrupt_controller.intc_plic_intc2.bridge_dynamic:
    extra_configs:
      - CONFIG_INTC2=y
      - CONFIG_INTC2_DYNAMIC=y
  drivers.interrupt_controller.intc_plic_intc2.affinity:
    # SMP variants: icount off, CONFIG_SMP=y and two CPUs from the board
    platform_allow:
      - qemu_riscv32/qemu_virt_riscv32/smp
      - qemu_riscv64/qemu_virt_riscv64/smp
    extra_configs:
      - CONFIG_INTC2=y
      - CONFIG_INTC2_AFFINITY=y
```

## tests/drivers/interrupt_controller/intc_x86_apic_intc2/testcase.yaml
```yaml
common:
  platform_allow:
    - qemu_x86_64
    - qemu_x86
  integration_platforms:
    - qemu_x86_64
  tags:
    - drivers
    - interrupt
    - intc2

tests:
  drivers.interrupt_controller.intc_x86_apic_intc2.legacy: {}
  drivers.interrupt_controller.intc_x86_apic_intc2.bridge:
    extra_configs:
      - CONFIG_INTC2=y
```

## tests/drivers/interrupt_controller/intc_x86_irq_alloc/testcase.yaml
```yaml
tests:
  drivers.interrupt_controller.intc_x86_irq_alloc:
    platform_allow:
      - qemu_x86_64
    integration_platforms:
      - qemu_x86_64
    tags:
      - drivers
      - interrupt
      - intc2
```

## tests/kernel/intc2_shim/dts/bindings/vnd,intc2-shim-dev.yaml
```yaml
# Copyright (c) 2026 Yong Cong Sin <yongcong.sin@gmail.com>
# SPDX-License-Identifier: Apache-2.0

description: intc2 legacy-backend shim test consumer (test only)

compatible: "vnd,intc2-shim-dev"

include: base.yaml
```
